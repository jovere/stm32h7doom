/*
 * debug_console.c
 *
 * Simple debug console implementation
 */

#include "debug_console.h"
#include "gfx.h"
#include "lcd.h"
#include <string.h>
#include <stdarg.h>
#include <stdio.h>

// Simple 8x8 bitmap font from VGA (subset of ASCII 32-127)
// Borrowed from Chocolate Doom textscreen library
static const unsigned char font_8x8[96][8] = {
    {0x00, 0x00, 0x00, 0x00, 0x00, 0x00, 0x00, 0x00}, // Space
    {0x18, 0x3C, 0x3C, 0x18, 0x18, 0x00, 0x18, 0x00}, // !
    {0x36, 0x36, 0x00, 0x00, 0x00, 0x00, 0x00, 0x00}, // "
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    {0x00, 0x00, 0x00, 0x00, 0x00, 0x00, 0x00, 0x00}  // DEL
};

// Console state
static char console_buffer[DEBUG_CONSOLE_MAX_LINES][DEBUG_CONSOLE_LINE_LENGTH];
static int console_line_count = 0;
static bool console_initialized = false;
static gfx_image_t console_image;

// Font rendering parameters
#define CHAR_WIDTH  8
#define CHAR_HEIGHT 8
#define LINE_SPACING 2
#define MARGIN_X 80
#define MARGIN_Y 10

void DebugConsole_Init(void)
{
    // Clear buffer
    memset(console_buffer, 0, sizeof(console_buffer));
    console_line_count = 0;

    // Initialize image for console rendering
    gfx_init_img(&console_image, LCD_MAX_X, LCD_MAX_Y, GFX_PIXEL_FORMAT_RGB565, RGB565_BLACK);

    console_initialized = true;
}

void DebugConsole_Clear(void)
{
    memset(console_buffer, 0, sizeof(console_buffer));
    console_line_count = 0;
    gfx_fill_img(&console_image, RGB565_BLACK);
}

void DebugConsole_Print(const char* text)
{
    if (!console_initialized)
        return;

    if (!text)
        return;

    // Add new line
    if (console_line_count < DEBUG_CONSOLE_MAX_LINES)
    {
        strncpy(console_buffer[console_line_count], text, DEBUG_CONSOLE_LINE_LENGTH - 1);
        console_buffer[console_line_count][DEBUG_CONSOLE_LINE_LENGTH - 1] = '\0';
        console_line_count++;
    }
    else
    {
        // Scroll: shift all lines up
        for (int i = 0; i < DEBUG_CONSOLE_MAX_LINES - 1; i++)
        {
            strcpy(console_buffer[i], console_buffer[i + 1]);
        }
        // Add new line at bottom
        strncpy(console_buffer[DEBUG_CONSOLE_MAX_LINES - 1], text, DEBUG_CONSOLE_LINE_LENGTH - 1);
        console_buffer[DEBUG_CONSOLE_MAX_LINES - 1][DEBUG_CONSOLE_LINE_LENGTH - 1] = '\0';
    }
}

void DebugConsole_Printf(const char* format, ...)
{
    char buffer[DEBUG_CONSOLE_LINE_LENGTH];
    va_list args;

    va_start(args, format);
    vsnprintf(buffer, sizeof(buffer), format, args);
    va_end(args);

    // Remove trailing newline if present
    size_t len = strlen(buffer);
    if (len > 0 && buffer[len - 1] == '\n')
        buffer[len - 1] = '\0';

    DebugConsole_Print(buffer);
}

// Draw a single character using the 8x8 font
static void draw_char(char c, uint16_t x, uint16_t y, uint32_t color)
{
    if (c < 32 || c > 126)
        c = ' '; // Replace unprintable with space

    const unsigned char *glyph = font_8x8[c - 32];

    for (int row = 0; row < 8; row++)
    {
        unsigned char byte = glyph[row];
        for (int col = 0; col < 8; col++)
        {
            // Read bits from LSB to MSB (reversed bit order)
            if (byte & (0x01 << col))
            {
                gfx_set_pixel(&console_image, x + col, y + row, color);
            }
        }
    }
}

void DebugConsole_Draw(void)
{
    if (!console_initialized)
        return;

    // Clear background
    gfx_fill_img(&console_image, RGB565_BLACK);

    // Draw each line
    uint16_t y = MARGIN_Y;
    for (int i = 0; i < console_line_count; i++)
    {
        uint16_t x = MARGIN_X;
        const char* line = console_buffer[i];

        for (int j = 0; line[j] != '\0' && j < DEBUG_CONSOLE_LINE_LENGTH; j++)
        {
            draw_char(line[j], x, y, RGB565_GREEN);
            x += CHAR_WIDTH;
        }

        y += CHAR_HEIGHT + LINE_SPACING;

        // Stop if we run out of screen space
        if (y + CHAR_HEIGHT > LCD_MAX_Y - MARGIN_Y)
            break;
    }

    // Copy console image to LCD
    gfx_coord_t coord;
    coord.source_x = 0;
    coord.source_y = 0;
    coord.source_w = LCD_MAX_X;
    coord.source_h = LCD_MAX_Y;
    coord.dest_x = 0;
    coord.dest_y = 0;

    gfx_draw_img(&console_image, &coord);
    gfx_refresh();
}
